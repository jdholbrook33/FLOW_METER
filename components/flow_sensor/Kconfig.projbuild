## components/flow_sensor/Kconfig.projbuild
```kconfig
menu "Flow Sensor Configuration"
    config FLOW_SENSOR_GPIO
        int "Flow Sensor GPIO Pin"
        default 3
        help
            GPIO number for flow sensor pulse input.

    config FLOW_SENSOR_PULSES_PER_LITER
        int "Pulses per Liter"
        default 300
        help
            Number of pulses per liter of flow (sensor calibration value).
            
    config FLOW_SENSOR_UPDATE_INTERVAL_MS
        int "Flow Rate Update Interval (ms)"
        default 1000
        range 100 10000
        help
            Interval in milliseconds to update flow rate calculation.
endmenu
```

## components/rtc_manager/Kconfig.projbuild
```kconfig
menu "RTC Manager Configuration"
    config I2C_MASTER_SCL
        int "SCL GPIO Number"
        default 7
        help
            GPIO number for I2C SCL.

    config I2C_MASTER_SDA
        int "SDA GPIO Number"
        default 6
        help
            GPIO number for I2C SDA.

    config TIMEZONE_OFFSET_HOURS
        int "Timezone offset from UTC (hours)"
        default -6
        help
            Hours to add/subtract from UTC (e.g., -6 for CST).

    config I2C_MASTER_FREQ_HZ
        int "I2C Master clock frequency"
        default 400000
        help
            I2C clock frequency for master mode. (400KHz)
endmenu
```
